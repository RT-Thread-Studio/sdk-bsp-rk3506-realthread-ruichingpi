## rt-thread/components/net_apps/pahomqtt/Kconfig
```kconfig
#-------------------------------------------------------------------------------
# RT-Thread RuiChing
# 
# COPYRIGHT (C) 2024-2025 Shanghai Real-Thread Electronic Technology Co., Ltd.
# All rights reserved.
# 
# The license and distribution terms for this file may be
# found in the file LICENSE in this distribution.
#-------------------------------------------------------------------------------
menuconfig COMP_USING_PAHOMQTT
  bool "Enable pahomqtt"
  default n

if COMP_USING_PAHOMQTT
	choice
		prompt "MQTT mode"
		help
			Select the MQTT Implementation

		config _PAHOMQTT_PIPE_MODE
			bool "Pipe mode: high performance and depends on DFS"
			select RT_USING_DEVICE_IPC

		config _PAHOMQTT_UDP_MODE
			bool "UDP mode: small footprint, need net supported loopback"
			select RT_LWIP_NETIF_LOOPBACK
	endchoice

	config MQTT_USING_TLS
		bool "Enable support tls protocol"
		default n
		select PKG_USING_MBEDTLS

	config MQTT_THREAD_STACK_SIZE
		int "Set MQTT thread stack size"
		default 4096

	config PAHOMQTT_SUBSCRIBE_HANDLERS
		int "Max pahomqtt subscribe topic handlers"
		default 1
		help
			Max pahomqtt subscribe topic handlers

	config MQTT_DEBUG
		bool "Enable debug log output"
		default y

endif
#-------------------------------------------------------------------------------
# End
#-------------------------------------------------------------------------------
```

## rt-thread/components/net_apps/tftp/Kconfig
```kconfig
#-------------------------------------------------------------------------------
# RT-Thread RuiChing
# 
# COPYRIGHT (C) 2024-2025 Shanghai Real-Thread Electronic Technology Co., Ltd.
# All rights reserved.
# 
# The license and distribution terms for this file may be
# found in the file LICENSE in this distribution.
#-------------------------------------------------------------------------------
menuconfig COMP_USING_TFTP
	bool "Enable tftp"
	default n

	if COMP_USING_TFTP
		config NETUTILS_TFTP_PORT
			int "TFTP server port"
			range 0 65535
			default 69
	endif

#-------------------------------------------------------------------------------
# End
#-------------------------------------------------------------------------------
```

## rt-thread/components/net_apps/webclient/Kconfig
```kconfig
#-------------------------------------------------------------------------------
# RT-Thread RuiChing
#
# COPYRIGHT (C) 2024-2025 Shanghai Real-Thread Electronic Technology Co., Ltd.
# All rights reserved.
#
# The license and distribution terms for this file may be
# found in the file LICENSE in this distribution.
#-------------------------------------------------------------------------------
menuconfig COMP_USING_WEBCLIENT
	bool "Enabel webclient"
	default n

	if COMP_USING_WEBCLIENT
  	config WEBCLIENT_DEBUG
  		bool "Enable debug log output"
  		default n

		config WEBCLIENT_USING_FILE_DOWMLOAD
			bool "Enable file download feature support"
			default n
			select RT_USING_POSIX_FS

		choice
			prompt "Select TLS mode"
			default COMPONENTS_WEBCLIENT_NOT_USE_TLS

				config COMPONENTS_WEBCLIENT_NOT_USE_TLS
					bool "Not support"

				config COMPONENTS_WEBCLIENT_USING_SAL_TLS
					bool "SAL TLS support"
					select SAL_USING_TLS

				config COMPONENTS_WEBCLIENT_USING_MBED_TLS
					bool "MbedTLS support"
					select COMP_USING_MBEDTLS
		endchoice
endif
#-------------------------------------------------------------------------------
# End
#-------------------------------------------------------------------------------
```

## rt-thread/components/net_apps/webnet/Kconfig
```kconfig
#-------------------------------------------------------------------------------
# RT-Thread RuiChing
#
# COPYRIGHT (C) 2024-2025 Shanghai Real-Thread Electronic Technology Co., Ltd.
# All rights reserved.
#
# The license and distribution terms for this file may be
# found in the file LICENSE in this distribution.
#-------------------------------------------------------------------------------
# Kconfig file for package webnet
menuconfig COMP_USING_WEBNET
    bool "Enabel webnet"
    default n

if COMP_USING_WEBNET

    config WEBNET_PORT
        int "Server listen port"
        default 80
        range 0 65535

    config WEBNET_CONN_MAX
        int "Maximum number of server connections"
        default 16
        range 1 100

    config WEBNET_ROOT
        string "Server root directory"
        default "/webnet"

    menu "Select supported modules"

        config WEBNET_USING_LOG
            bool "LOG: Enable output log support"
            default n

        config WEBNET_USING_AUTH
            bool "AUTH: Enable basic HTTP authentication support"
            default n

        config WEBNET_USING_CGI
            bool "CGI: Enable Common Gateway Interface support"
            default n

        config WEBNET_USING_ASP
            bool "ASP: Enable Active Server Pages support"
            default n

        config WEBNET_USING_SSI
            bool "SSI: Enable Server Side Includes support"
            default n

        config WEBNET_USING_INDEX
            bool "INDEX: Enable list all the file in the directory support"
            default n

        config WEBNET_USING_ALIAS
            bool "ALIAS: Enable alias support"
            default n

        config WEBNET_USING_DAV
            bool "DAV: Enable Web-based Distributed Authoring and Versioning support"
            default n

        config WEBNET_USING_UPLOAD
            bool "UPLOAD: Enable upload file support"
            default n

        config WEBNET_USING_GZIP
            bool "GZIP: Enable compressed file support by GZIP"
            default n

        config WEBNET_CACHE_LEVEL
            int "CACHE: Configure cache level(0:disable 1:use Last-Modified 2:use Cache-Control)"
            default 0
            range 0 2

        if WEBNET_CACHE_LEVEL = 2

            config WEBNET_CACHE_MAX_AGE
            int "Cache-Control time in seconds"
            default 1800

        endif

        if WEBNET_USING_SSI

            config WEBNET_USING_SSI_VIRTUAL_HANDLER
                bool "SSI: Enable Virtual callback handler"
                depends on WEBNET_USING_SSI
                default n

        endif

    endmenu

endif

#-------------------------------------------------------------------------------
# End
#-------------------------------------------------------------------------------
```
