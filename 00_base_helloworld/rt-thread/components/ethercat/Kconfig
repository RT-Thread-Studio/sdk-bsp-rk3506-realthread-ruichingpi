## rt-thread/components/graphics/lvgl/Kconfig
```kconfig
#-------------------------------------------------------------------------------
# RT-Thread RuiChing
#
# COPYRIGHT (C) 2024-2025 Shanghai Real-Thread Electronic Technology Co., Ltd.
# All rights reserved.
#
# The license and distribution terms for this file may be
# found in the file LICENSE in this distribution.
#-------------------------------------------------------------------------------
menuconfig COMP_USING_LVGL
    bool "Enable LVGL"
    default n

if COMP_USING_LVGL

    config RT_LVGL_THREAD_PRIO
        int "Priority of LVGL thread"
        default 20

    config RT_LVGL_THREAD_STACK_SIZE
        int "Stack size of LVGL thread"
        default 8192

    config LV_DEF_REFR_PERIOD
        int "Default refresh period (ms)"
        default 33
        help
            Default display refresh, input device read and animation step period.

    config COMP_USING_LVGL_SQUARELINE
        bool "Support SquareLine Studio"
        default n

    config RT_LVGL_VER_NUM
        hex
        default 0x090100

    config RT_LVGL_VER
        string
        default "v9.1.0"

    # Define CONFIG_LV_CONF_SKIP so we can use LVGL
    # without lv_conf.h file, the lv_conf_internal.h and
    # lv_conf_kconfig.h files are used instead.
    config LV_CONF_SKIP
        bool
        default y

    menu "Color Settings"
        choice LV_COLOR_DEPTH
            prompt "Color depth"
            default COLOR_DEPTH_24
            help
                Color depth to be used.

            config COLOR_DEPTH_32
                bool "32: XRGB8888"
            config COLOR_DEPTH_24
                bool "24: RGB888"
            config COLOR_DEPTH_16
                bool "16: RGB565"
            config COLOR_DEPTH_8
                bool "8: RGB232"
            config COLOR_DEPTH_1
                bool "1: 1 byte per pixel"
        endchoice

        config LV_COLOR_DEPTH
            int
            default 1 if COLOR_DEPTH_1
            default 8 if COLOR_DEPTH_8
            default 16 if COLOR_DEPTH_16
            default 24 if COLOR_DEPTH_24
            default 32 if COLOR_DEPTH_32
    endmenu

endif

#-------------------------------------------------------------------------------
# End
#-------------------------------------------------------------------------------
```

## rt-thread/components/graphics/rga/Kconfig
```kconfig
#-------------------------------------------------------------------------------
# RT-Thread RuiChing
#
# COPYRIGHT (C) 2024-2025 Shanghai Real-Thread Electronic Technology Co., Ltd.
# All rights reserved.
#
# The license and distribution terms for this file may be
# found in the file LICENSE in this distribution.
#-------------------------------------------------------------------------------
menu "RT-Thread rockchip rga driver"
	config RT_USING_RGA
		bool "Enable rga"
		default n
	orsource '*/Kconfig'
endmenu

#-------------------------------------------------------------------------------
# End
#-------------------------------------------------------------------------------
```

## rt-thread/components/industrial_bus/CanFestival/Kconfig
```kconfig
#-------------------------------------------------------------------------------
# RT-Thread RuiChing
# 
# COPYRIGHT (C) 2024-2025 Shanghai Real-Thread Electronic Technology Co., Ltd.
# All rights reserved.
# 
# The license and distribution terms for this file may be
# found in the file LICENSE in this distribution.
#-------------------------------------------------------------------------------
menuconfig COMP_USING_CANFESTIVAL
	bool "Enable CanFestival"
	select RT_USING_CAN
	select RT_USING_HWTIMER
	default n
	help
		CanFestival focuses on providing an ANSI-C platform independent
		CANOpen stack that can be built as master or slave nodes on
		PCs, Real-time IPCs, and Microcontrollers.

	if COMP_USING_CANFESTIVAL
		config CANFESTIVAL_CAN_DEVICE_NAME
			string "CAN device name for CanFestival"
			default "can0"

		config CANFESTIVAL_TIMER_DEVICE_NAME
			string "hwtimer device name for CanFestival"
			default "timer0"

		config CANFESTIVAL_RECV_THREAD_PRIO
			int "The priority level value of can receive thread"
			default 9

		config CANFESTIVAL_TIMER_THREAD_PRIO
			int "The priority level value of timer thread"
			default 10

endif
#-------------------------------------------------------------------------------
# End
#-------------------------------------------------------------------------------
```

## rt-thread/components/language/Kconfig
```kconfig
#-------------------------------------------------------------------------------
# RT-Thread RuiChing
# 
# COPYRIGHT (C) 2024-2025 Shanghai Real-Thread Electronic Technology Co., Ltd.
# All rights reserved.
# 
# The license and distribution terms for this file may be
# found in the file LICENSE in this distribution.
#-------------------------------------------------------------------------------
menu "Language"
	orsource '*/Kconfig'
endmenu

#-------------------------------------------------------------------------------
# End
#-------------------------------------------------------------------------------
```

## rt-thread/components/language/micropython/Kconfig
```kconfig
#-------------------------------------------------------------------------------
# RT-Thread RuiChing
# 
# COPYRIGHT (C) 2024-2025 Shanghai Real-Thread Electronic Technology Co., Ltd.
# All rights reserved.
# 
# The license and distribution terms for this file may be
# found in the file LICENSE in this distribution.
#-------------------------------------------------------------------------------
config COMP_USING_MICROPYTHON
	bool "Enable MicroPython"
	default n

#-------------------------------------------------------------------------------
# End
#-------------------------------------------------------------------------------
```
