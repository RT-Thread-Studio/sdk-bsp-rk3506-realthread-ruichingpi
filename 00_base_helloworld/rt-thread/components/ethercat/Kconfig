## 00_base_helloworld/rt-thread/components/ethercat/Kconfig
```kconfig
#-------------------------------------------------------------------------------
# RT-Thread Secure
# Copyright (c) Shanghai Real-Thread Electronic Technology Co., Ltd.
# All rights reserved.
#-------------------------------------------------------------------------------

menuconfig COMPONENTS_ETHERCAT_ENABLE
	bool "Enable EtherCAT Master"
	default n
	help
	  Enable EtherCAT Master.

#-------------------------------------------------------------------------------
# End
#-------------------------------------------------------------------------------
```

## 02_peripheral_gpio_input_interrupt/Kconfig
```kconfig
#-------------------------------------------------------------------------------
# RT-Thread RuiChing
# Copyright (c) Shanghai Real-Thread Electronic Technology Co., Ltd.
# All rights reserved.
#-------------------------------------------------------------------------------
mainmenu "RuiChing APP Project Configure"

config PKGS_DIR
    string
    option env="PKGS_ROOT"
    default "packages"

orsource 'rt-thread/Kconfig'
```

## 02_peripheral_gpio_input_interrupt/rt-thread/Kconfig
```kconfig
#-------------------------------------------------------------------------------
# RT-Thread Secure
# Copyright (c) Shanghai Real-Thread Electronic Technology Co., Ltd.
# All rights reserved.
#-------------------------------------------------------------------------------
orsource 'components/Kconfig'

orsource "$PKGS_DIR/Kconfig"
```

## 02_peripheral_saradc/rt-thread/components/rt_perf/Kconfig
```kconfig
menuconfig PKG_USING_RT_PERF
    bool "rt_perf: RT-Thread Secure Performance"
    default n

if PKG_USING_RT_PERF
    config RT_PERF_TIMER_FREQ
        int "Set Timer Freq(Hz)"
        range 1000000 1000000000
        default 100000000
    
    config RT_PERF_TIMER_BITS
        int "Set Timer Bits"
        range 1 32
        default 32

    menuconfig RT_PERF_EXPORT_CSV_DATA
        bool "Export CSV Data "
        default n
        if RT_PERF_EXPORT_CSV_DATA
            config RT_PERF_EXPORT_CSV_DATA_PATH
                string "File Path"
                default "/mnt"
        endif

    menuconfig RT_PERF_ENABLE_IRQ_LATENCY
        bool "Enable irq latency"
        default n
        if RT_PERF_ENABLE_IRQ_LATENCY
            config RT_PERF_USING_TIMER_NAME
                string "Select timer name"
                default "timer3"
        endif

    choice
        prompt "Version"
        help
            Select the rt_perf version
            default PKG_USING_RT_PERF_V003

        config PKG_USING_RT_PERF_V003
            bool "v0.0.3"
    endchoice

endif
```

## 03_network_tcp_server/rt-thread/components/modbus/Kconfig
```kconfig
#-------------------------------------------------------------------------------
# RT-Thread Secure
# Copyright (c) Shanghai Real-Thread Electronic Technology Co., Ltd.
# All rights reserved.
#-------------------------------------------------------------------------------

menuconfig COMPONENTS_MODBUS_ENABLE
	bool "Enable Modbus"
	default n
	help
	  Enable Modbus support.

#-------------------------------------------------------------------------------
# End
#-------------------------------------------------------------------------------
```

## 03_network_telnet/rt-thread/components/finsh/Kconfig
```kconfig
#-------------------------------------------------------------------------------
# RT-Thread Secure
# Copyright (c) Shanghai Real-Thread Electronic Technology Co., Ltd.
# All rights reserved.
#-------------------------------------------------------------------------------

menuconfig COMPONENTS_FINSH_EXPORT_ENABLE
	bool "Enable Finsh Export"
	default n
	help
	  Enable Finsh Export.

#-------------------------------------------------------------------------------
# End
#-------------------------------------------------------------------------------
```

## 03_network_udp_client/rt-thread/components/iperf/kconfig
```kconfig
menuconfig PKG_USING_NETUTILS
    bool "netutils: Networking utilities for RT-Thread"
    default n

if PKG_USING_NETUTILS

    config PKG_NETUTILS_IPERF
        bool "Enable iperf-liked network performance tool"
        select RT_USING_LIBC            if RT_VER_NUM < 0x40100
        select RT_USING_SAL             if RT_VER_NUM < 0x40100
        select SAL_USING_POSIX          if RT_VER_NUM < 0x40100
        select RT_USING_POSIX_FS        if RT_VER_NUM >= 0x40100
        select RT_USING_POSIX_SOCKET    if RT_VER_NUM >= 0x40100
        default n

    config IPERF_THREAD_STACK_SIZE
        int "the stack size of iperf thread"
        depends on PKG_NETUTILS_IPERF
        range 2048 65536
        default 16384 if ARCH_CPU_64BIT
        default 2048

    config PKG_NETUTILS_VER
        string
        default "v1.3.3" if PKG_USING_NETUTILS_V133
        default "v1.3.2" if PKG_USING_NETUTILS_V132
        default "v1.3.1" if PKG_USING_NETUTILS_V131
        default "v1.3.0" if PKG_USING_NETUTILS_V130
        default "v1.2.0" if PKG_USING_NETUTILS_V120
        default "v1.1.0" if PKG_USING_NETUTILS_V110
        default "v1.0.0" if PKG_USING_NETUTILS_V100
        default "latest" if PKG_USING_NETUTILS_LATEST_VERSION

    config PKG_NETUTILS_VER_NUM
        hex
        default 0x99999    if PKG_USING_NETUTILS_LATEST_VERSION
        default 0x10303    if PKG_USING_NETUTILS_V133
        default 0x10302    if PKG_USING_NETUTILS_V132
        default 0x10301    if PKG_USING_NETUTILS_V131
        default 0x10300    if PKG_USING_NETUTILS_V130
        default 0x10200    if PKG_USING_NETUTILS_V120
        default 0x10100    if PKG_USING_NETUTILS_V110
        default 0x10000    if PKG_USING_NETUTILS_V100

endif
```

## 03_network_udp_server/Kconfig
```kconfig
#-------------------------------------------------------------------------------
# RT-Thread RuiChing
# Copyright (c) Shanghai Real-Thread Electronic Technology Co., Ltd.
# All rights reserved.
#-------------------------------------------------------------------------------
mainmenu "RuiChing APP Project Configure"

orsource 'rt-thread/Kconfig'
```

## 04_filesystem_file/rt-thread/components/service/Kconfig
```kconfig
#-------------------------------------------------------------------------------
# RT-Thread Secure
# Copyright (c) Shanghai Real-Thread Electronic Technology Co., Ltd.
# All rights reserved.
#-------------------------------------------------------------------------------

menuconfig RT_USING_SERVICE
	bool "Enable Kernel Service"
	default n
	help
		Enable Kernel Service support.

#-------------------------------------------------------------------------------
# End
#-------------------------------------------------------------------------------
```

## 05_gui_lvgl_mipi_ruiching_7in_1024_600/rt-thread/components/CanFestival/Kconfig
```kconfig
# Kconfig file for package canfestival
menuconfig BSP_USING_CANFESTIVAL
    bool "Enable CanFestival"
    default n

    if BSP_USING_CANFESTIVAL
        config BSP_CANFESTIVAL_CAN_DEVICE_NAME
            string "CAN device name for CanFestival"
            default "ff320000.can"

        config BSP_CANFESTIVAL_TIMER_DEVICE_NAME
            string "hwtimer device name for CanFestival"
            default "timer0"

        config BSP_CANFESTIVAL_RECV_THREAD_PRIO
            int "The priority level value of can receive thread"
            default 9

        config BSP_CANFESTIVAL_TIMER_THREAD_PRIO
            int "The priority level value of timer thread"
            default 10
    endif
```

## rt-thread/components/Kconfig
```kconfig
#-------------------------------------------------------------------------------
# RT-Thread RuiChing
#
# COPYRIGHT (C) 2024-2025 Shanghai Real-Thread Electronic Technology Co., Ltd.
# All rights reserved.
#
# The license and distribution terms for this file may be
# found in the file LICENSE in this distribution.
#-------------------------------------------------------------------------------
menu 'RuiChing Components Configure'
	orsource 'industrial_bus/Kconfig'
	orsource 'net_apps/Kconfig'
	orsource 'graphics/Kconfig'
	orsource 'ai/Kconfig'
	orsource 'data_parsers/Kconfig'
	orsource 'debug/Kconfig'
	orsource 'language/Kconfig'
	orsource 'security/Kconfig'
endmenu

#-------------------------------------------------------------------------------
# End
#-------------------------------------------------------------------------------
```

## rt-thread/components/ai/ncnn/Kconfig
```kconfig
#-------------------------------------------------------------------------------
# RT-Thread RuiChing
# 
# COPYRIGHT (C) 2024-2025 Shanghai Real-Thread Electronic Technology Co., Ltd.
# All rights reserved.
# 
# The license and distribution terms for this file may be
# found in the file LICENSE in this distribution.
#-------------------------------------------------------------------------------
config COMP_USING_NCNN
    bool "Enable ncnn"
    default n
    select RT_USING_CPLUSPLUS 
    select RT_USING_FPU 
    help
        Enable the ncnn deep learning framework.
        This will automatically enable C++ support.

#-------------------------------------------------------------------------------
# End
#-------------------------------------------------------------------------------
```

## rt-thread/components/ai/opencv/Kconfig
```kconfig
#-------------------------------------------------------------------------------
# RT-Thread RuiChing
# 
# COPYRIGHT (C) 2024-2025 Shanghai Real-Thread Electronic Technology Co., Ltd.
# All rights reserved.
# 
# The license and distribution terms for this file may be
# found in the file LICENSE in this distribution.
#-------------------------------------------------------------------------------
config COMP_USING_OPENCV
    bool "Enable OpenCV"
    default n
    select RT_USING_CPLUSPLUS 
    select RT_USING_FPU 

#-------------------------------------------------------------------------------
# End
#-------------------------------------------------------------------------------
```

## rt-thread/components/data_parsers/sqlite/Kconfig
```kconfig
#-------------------------------------------------------------------------------
# RT-Thread RuiChing
# 
# COPYRIGHT (C) 2024-2025 Shanghai Real-Thread Electronic Technology Co., Ltd.
# All rights reserved.
# 
# The license and distribution terms for this file may be
# found in the file LICENSE in this distribution.
#-------------------------------------------------------------------------------

menuconfig COMP_USING_SQLITE
    bool "Enable sqlite"
    default n

if COMP_USING_SQLITE
    config COMP_USING_SQLITE_SQL_MAX_LEN
        int "SQL statements max length"
        default 1024

    config COMP_USING_SQLITE_DB_NAME_MAX_LEN
        int "Database filename(fullpath) length"
        range 8 256
        default 64
endif

#-------------------------------------------------------------------------------
# End
#-------------------------------------------------------------------------------
```

## rt-thread/components/debug/coredump/Kconfig
```kconfig
#-------------------------------------------------------------------------------
# RT-Thread RuiChing
# 
# COPYRIGHT (C) 2024-2025 Shanghai Real-Thread Electronic Technology Co., Ltd.
# All rights reserved.
# 
# The license and distribution terms for this file may be
# found in the file LICENSE in this distribution.
#-------------------------------------------------------------------------------
menuconfig COMP_USING_COREDUMP
	bool "Enable coredump"
	help
		Enable core dump feature to save system state when crashes occur.
		Includes register values, stack traces, and memory regions.

if COMP_USING_COREDUMP

	choice
		prompt "Storage Backend"
		default COREDUMP_STORAGE_FILE_AND_RAM
		help
			Select storage backend(s) for coredump files.

		config COREDUMP_STORAGE_RAM
			bool "RAM only"
			help
				Save coredump only to RAM (fast but volatile).

		config COREDUMP_STORAGE_FILE
			bool "FILE only"
			help
				Save coredump to filesystem (persistent but slower).

		config COREDUMP_STORAGE_FILE_AND_RAM
			bool "RAM + FILE"
			help
				Save to both RAM and filesystem (redundant storage).
	endchoice

	config COREDUMP_MAX_SIZE_KB
		int "Maximum CoreDump Size (KB)"
		default 2048
		help
			Limits the dump size to prevent storage overflow.
			RAM-only mode has smaller max size (10MB) due to memory constraints.

	config COREDUMP_FILE_SAVE_PATH
		string "File Save Path"
		default "/sdmmc/core.dump"
		help
			Path for file-based storage (e.g. /sdmmc/core.dump or /flash/crash.dump).

endif

#-------------------------------------------------------------------------------
# End
#-------------------------------------------------------------------------------
```

## rt-thread/components/debug/iperf2/Kconfig
```kconfig
#-------------------------------------------------------------------------------
# RT-Thread RuiChing
# 
# COPYRIGHT (C) 2024-2025 Shanghai Real-Thread Electronic Technology Co., Ltd.
# All rights reserved.
# 
# The license and distribution terms for this file may be
# found in the file LICENSE in this distribution.
#-------------------------------------------------------------------------------
menuconfig COMP_USING_IPERF2
	bool "Enable iperf2"
	default n

	if COMP_USING_IPERF2
		config IPERF_THREAD_STACK_SIZE
			int "the stack size of iperf thread"
			range 4096 65536
			default 16384 if ARCH_CPU_64BIT
			default 8192
	endif

#-------------------------------------------------------------------------------
# End
#-------------------------------------------------------------------------------
```

## rt-thread/components/debug/rt_perf/Kconfig
```kconfig
#-------------------------------------------------------------------------------
# RT-Thread RuiChing
# 
# COPYRIGHT (C) 2024-2025 Shanghai Real-Thread Electronic Technology Co., Ltd.
# All rights reserved.
# 
# The license and distribution terms for this file may be
# found in the file LICENSE in this distribution.
#-------------------------------------------------------------------------------
menuconfig COMP_USING_RT_PERF
	bool "Enable rt_perf"
	default n

	if COMP_USING_RT_PERF
		config RT_PERF_TIMER_FREQ
			int "Set Timer Freq(Hz)"
			range 1000000 1000000000
			default 24000000

		config RT_PERF_TIMER_BITS
			int "Set Timer Bits"
			range 1 32
			default 32

		menuconfig RT_PERF_EXPORT_CSV_DATA
			bool "Export CSV Data"
			default n
			if RT_PERF_EXPORT_CSV_DATA
				config RT_PERF_EXPORT_CSV_DATA_PATH
					string "File Path"
					default "/mnt"
			endif

		menuconfig RT_PERF_ENABLE_IRQ_LATENCY
			bool "Enable irq latency"
			default n
			if RT_PERF_ENABLE_IRQ_LATENCY
				config RT_PERF_USING_TIMER_NAME
					string "Select timer name"
					default "timer3"
			endif
endif
#-------------------------------------------------------------------------------
# End
#-------------------------------------------------------------------------------
```
